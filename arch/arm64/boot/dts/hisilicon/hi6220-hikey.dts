/*
 * dts file for Hisilicon HiKey Development Board
 *
 * Copyright (C) 2015, Hisilicon Ltd.
 *
 */

/dts-v1/;

/memreserve/ 0x05E00000 0x00100000;

#include "hi6220.dtsi"

/ {
	model = "HiKey Development Board";
	compatible = "hisilicon,hikey", "hisilicon,hi6220";
	#address-cells = <2>;
	#size-cells = <2>;
	interrupt-parent = <&gic>;

	aliases {
		serial0 = &uart0;
	};

	chosen { };

	memory@0 {
		device_type = "memory";
		reg = <0x0 0x0 0x0 0x38c00000>;
	};
};
