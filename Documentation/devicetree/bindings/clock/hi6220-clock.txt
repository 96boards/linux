## Documentation/devicetree/bindings/clock/hi6220-clock.txt
```
* Hisilicon Hi6220 Clock Controller

The hi6220 clock controller generates and supplies clock to various
controllers within the hi6220 SoC.

Required Properties:

- compatible: should be one of the following:
  - "hisilicon,hi6220-clock-ao" - controller for those clocks under SoC
     power always on(AO) domain, it is the sub node of SoC power AO
     controller in dts file.
  - "hisilicon,hi6220-clock-sys" - controller for those clocks under SoC
     system control domain, it is the sub node of SoC system controller
     in dts file.
  - "hisilicon,hi6220-clock-media" - controller for those clocks under
     SoC media control domain, it is the sub node of SoC media controller
     in dts file.
  - "hisilicon,hi6220-clock-power" - controller for those clocks under
     SoC power control domain, it is the sub node of SoC power controller
     in dts file.

- reg: physical base address of the controller and length of memory mapped
  region.

- #clock-cells: should be 1.

Each clock is assigned an identifier and client nodes use this identifier
to specify the clock which they consume.

All these identifier could be found in <dt-bindings/clock/hi6220-clock.h>.
```

## Documentation/devicetree/bindings/mailbox/hisi-mailbox.txt
```
Hisilicon Mailbox Driver
========================

Hisilicon mailbox can support maximum 32 channels. Every channel supports
only one direction for data transferring, the maximum message data size is 8
bytes. For sending data, need set the register for channel's mode, and
trigger the interrupt for remote core. For receiving data, kernel will
handle interrupt and transfer data to mailbox framework.

Mailbox Device Node:
====================

Required properties:
--------------------
- compatible:		Shall be "hisilicon,hi6220-mbox"
- reg:			Contains the mailbox register address range (base
			address and length); the first item is for IPC
			registers, the second item is shared buffer for
			slots.
- #mbox-cells		Shall be 1 - the index of the channel needed.
- interrupts:		Contains the interrupt information for the mailbox
			device. The format is dependent on which interrupt
			controller the SoCs use.

Example:
--------

	mailbox: mailbox@F7510000 {
		#mbox-cells = <1>;
		compatible = "hisilicon,hi6220-mbox";
		reg = <0x0 0xF7510000 0x0 0x1000>, /* IPC_S */
		      <0x0 0x06DFF800 0x0 0x0800>; /* Mailbox */
		interrupt-parent = <&gic>;
		interrupts = <0 94 4>;
	};
```

## drivers/clk/hisilicon/Kconfig
```kconfig
config COMMON_CLK_HI6220
	tristate "Hi6220 Clock Driver"
	depends on OF && (ARCH_HISI || COMPILE_TEST) && MAILBOX
	help
	  Build the Hisilicon Hi6220 clock driver based on the common clock framework.
```

## drivers/mailbox/hisilicon/Kconfig
```kconfig
config HISI_MBOX
	bool "Hisilicon's Mailbox"
	depends on ARCH_HISI
	help
	  Support for mailbox drivers on Hisilicon series of SoCs.

config HI6220_MBOX
	tristate "Hi6220 Mailbox Controller"
	depends on HISI_MBOX
	help
	  An implementation of the hi6220 mailbox. It is used to send message
	  between application processors and MCU. Say Y here if you want to build
	  the Hi6220 mailbox controller driver.
```
